## Kconfig
```kconfig
config ZMK_KEY_STATS
    bool "Track physical key press statistics"
    default n
    depends on SETTINGS
    help
      Count only ZMK physical key position press events. Encoder sensor events and pointing
      input events are intentionally not counted.

config ZMK_KEY_STATS_SAVE_DEBOUNCE_SECONDS
    int "Delay before saving key statistics"
    default 30
    depends on ZMK_KEY_STATS

config ZMK_KEY_STATS_SAVE_PRESS_INTERVAL
    int "Save key statistics every N key presses"
    default 50
    depends on ZMK_KEY_STATS

config ZMK_DONGLE_MONITOR
    bool "Build the display receiver as a BLE status monitor"
    default n
    depends on BT && BT_OBSERVER && ZMK_DISPLAY
    help
      Listen for Prospector-compatible keyboard status advertisements instead
      of acting as the split keyboard central. The OLED theme code is shared
      with the normal dongle build.

config ZMK_DONGLE_MONITOR_CHANNEL
    int "Prospector channel accepted by the monitor"
    range 0 255
    default 0
    depends on ZMK_DONGLE_MONITOR
    help
      Zero accepts every Prospector channel. A non-zero value accepts that
      channel and keyboards broadcasting on channel zero.

config NOIRIX_ST7789V_RGB565
    bool "ST7789V display uses the RGB565 pixel format (direct-SPI driver)"
    default y
    depends on ZMK_DONGLE_MONITOR
    help
      The ported direct-SPI ST7789V driver (carrefinho/prospector-zmk-module
      style) selects a 2-byte-per-pixel format when this option is enabled.
      This symbol replaces the in-tree CONFIG_ST7789V_RGB565, which is part
      of Zephyr's MIPI-DBI ST7789V Kconfig choice and is not available when
      the in-tree driver is not used.
```

## dts/bindings/display/noirix,st7789v.yaml
```yaml
# Copyright (c) 2019, Marc Reilly <marc@cpdesign.com.au>
# Copyright (c) 2019, PHYTEC Messtechnik GmbH
# Copyright (c) 2026 NoirGuo
# SPDX-License-Identifier: Apache-2.0

description: |
  ST7789V display controller driven over a raw SPI bus with a separate
  command/data (D/C) GPIO line.

  This is the "legacy" SPI-direct-drive binding kept by the Noirix44 monitor
  port (carrefinho/prospector-zmk-module style).  The Zephyr 4.1 in-tree
  "sitronix,st7789v" binding uses the MIPI-DBI wrapper and requires a
  mipi-mode property, which is incompatible with the direct-SPI node layout
  used here; hence the custom compatible.

compatible: "noirix,st7789v"

include: [spi-device.yaml]

properties:
  cmd-data-gpios:
    type: phandle-array
    required: true
    description: |
      Command/Data (D/C) GPIO. High = command, low = data (the driver toggles
      it around each SPI write).

  reset-gpios:
    type: phandle-array
    description: |
      Optional reset GPIO. When present, the driver pulses it at init;
      otherwise it falls back to the ST7789V software reset command.

  width:
    type: int
    required: true
    description: Display width in pixels (e.g. 240)

  height:
    type: int
    required: true
    description: Display height in pixels (e.g. 240)

  x-offset:
    type: int
    required: true
    description: Column offset of the visible panel in the controller RAM

  y-offset:
    type: int
    required: true
    description: Row offset of the visible panel in the controller RAM

  vcom:
    type: int
    required: true
    description: VCOM Setting

  gctrl:
    type: int
    required: true
    description: Gate Control

  vrhs:
    type: int
    description: VRH Setting

  vdvs:
    type: int
    description: VDV Setting

  mdac:
    type: int
    required: true
    description: Memory Data Access Control

  lcm:
    type: int
    required: true
    description: LCM Setting

  colmod:
    type: int
    required: true
    description: Interface Pixel Format

  gamma:
    type: int
    required: true
    description: Gamma Setting

  porch-param:
    type: uint8-array
    required: true
    description: Porch Setting

  cmd2en-param:
    type: uint8-array
    required: true
    description: Command 2 Enable Parameter

  pwctrl1-param:
    type: uint8-array
    required: true
    description: Power Control 1 Parameter

  pvgam-param:
    type: uint8-array
    required: true
    description: Positive Voltage Gamma Control Parameter

  nvgam-param:
    type: uint8-array
    required: true
    description: Negative Voltage Gamma Control Parameter

  ram-param:
    type: uint8-array
    required: true
    description: RAM Control Parameter

  rgb-param:
    type: uint8-array
    required: true
    description: RGB Interface Control Parameter
```

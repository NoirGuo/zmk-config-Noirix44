## boards/shields/noirix44/Kconfig.defconfig
```kconfig
# Copyright (c) 2022 Duccio Breschi
# SPDX-License-Identifier: MIT

if SHIELD_NOIRIX44_LEFT

config ZMK_KEYBOARD_NAME
    default "noirix44"

config ZMK_SPLIT_ROLE_CENTRAL
    default y

endif

if SHIELD_NOIRIX44_LEFT || SHIELD_NOIRIX44_RIGHT

config ZMK_SPLIT
    default y

endif
```

## boards/shields/noirix44/Kconfig.shield
```kconfig
# Copyright (c) 2022 Duccio Breschi
# SPDX-License-Identifier: MIT

config SHIELD_NOIRIX44_LEFT
    def_bool $(shields_list_contains,noirix44_left)

config SHIELD_NOIRIX44_RIGHT
    def_bool $(shields_list_contains,noirix44_right)
```

## config/west.yml
```yaml
manifest:
  defaults:
    revision: main
  remotes:
    - name: cormoran
      url-base: https://github.com/cormoran
    - name: englmaxi
      url-base: https://github.com/englmaxi
  projects:
    - name: zmk
      remote: cormoran
      revision: v0.3-branch+dya
      import: app/west.yml
    - name: zmk-module-ble-management
      remote: cormoran
      revision: main
    - name: zmk-module-battery-history
      remote: cormoran
      revision: main
    - name: zmk-module-settings-rpc
      remote: cormoran
      revision: main
    - name: zmk-module-runtime-input-processor
      remote: cormoran
      revision: main
    - name: zmk-dongle-display
      remote: englmaxi
      revision: v0.3
  self:
    path: config
```
